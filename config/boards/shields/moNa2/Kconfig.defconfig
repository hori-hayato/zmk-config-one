## config/boards/shields/moNa2/Kconfig.defconfig
```kconfig
if SHIELD_MONA2_R

config ZMK_KEYBOARD_NAME
    default "moNa2_R"

config ZMK_SPLIT
    default y

config ZMK_SPLIT_ROLE_CENTRAL
    default y

# Other settings

config ZMK_POINTING
    default y

# Assuming pointing device uses SPI
config SPI
    default y

endif

if SHIELD_MONA2_L

config ZMK_KEYBOARD_NAME
    default "moNa2_L"

config ZMK_SPLIT
    default y

endif
```
